## boards/shields/eli/Kconfig
```kconfig
if SHIELD_MI_TECLADO

config ZMK_KEYBOARD_NAME
    default "MiTeclado100"

endif
```

## boards/shields/eli/Kconfig.defconfig
```kconfig
if SHIELD_ELI

config GPIO
    def_bool y

config I2C
    def_bool y

config GPIO_MCP23017
    def_bool y
    select I2C

endif
```

## boards/shields/eli/dts/bindings/microchip,mcp23017.yaml
```yaml
description: MCP23017 I2C-based GPIO expander
compatible: "microchip,mcp23017"
include: [gpio-controller.yaml, i2c-device.yaml]
properties:
    reg:
      required: true
    "#gpio-cells":
      const: 2
    int-gpios:
      type: phandle-array
      required: false
gpio-cells:
  - pin
  - flags
```

## config/west.yml
```yaml
manifest:
  defaults:
    revision: v0.3
  remotes:
    - name: zmkfirmware
      url-base: https://github.com/zmkfirmware
  projects:
    - name: zmk
      remote: zmkfirmware
      import: app/west.yml
    - name: node-free-config
      url: https://github.com/petejohanson/zmk-node-free-config
      revision: main
  self:
    path: config
```
